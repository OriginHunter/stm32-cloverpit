#include "headerfile.h"

extern uint8_t key;
extern uint8_t key1_0,key1_1;
extern uint8_t key2_0,key2_1;
extern uint8_t key3_0,key3_1;
extern uint8_t key4_0,key4_1;
uint32_t ms;
uint32_t random32bit;
uint16_t count;
uint16_t capture_value;
uint16_t fre;
uint8_t n = 35;
uint8_t mode = 0;
uint8_t s = 55;
uint8_t m = 59;
uint8_t h = 23;
uint8_t led = 0x01;
char text[20];
char result[3][5] = {
{0,1,2,3,4,},
{4,3,2,1,0,},
{0,1,2,3,4,}
};
const uint16_t Clover[462] = {
    0x39E7, 0x39E7, 0x39E7, 0x39E7, 0x4208, 0x4208, 0x4208, 0x39E7, 0x39E7, 0x39E7, 
    0x4208, 0x39E7, 0x39E7, 0x39E7, 0x39E7, 0x39E7, 0x39E7, 0x4208, 0x39E7, 0x4208, 
    0x39E7, 0x4208, 0x4208, 0x39E7, 0x39E7, 0x4208, 0x39E7, 0x4208, 0x39E7, 0x39E7, 
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    0x39E7, 0x39E7, 
};

//  char slot[5] = {'0','1','2','3','4'};
//  uint16_t base_x = 200;

//  for(int i = 0; i < 5; i++)
//  {
//      LCD_DisplayChar(Line3, base_x - i*20, slot[i]);
//  }

void fun_Init(void)
{
  LED_Init();
  LCD_Init();
	HAL_Delay(100);;
  HAL_TIM_Base_Start_IT(&htim2);
  HAL_GPIO_WritePin(GPIOD, GPIO_PIN_2, GPIO_PIN_SET);
  LCD_SetBackColor(Black);
  LCD_SetTextColor(White);
  LCD_Clear(Black);
  HAL_Delay(100);
  LCD_MySetDisplayWindow(20, 20, 21, 22);
  LCD_MyDrawPicture(Clover);
}

void fun(void)
{
  LED_Show();
  LCD_Show();
  key = KEY_Scan(ms);
  if(key)
  {
  sprintf(text,"     key: %d      ",key);
  LCD_DisplayStringLine(Line3, (unsigned char *)text);
    if(key == 1)
    {
      HAL_RNG_GenerateRandomNumber(&hrng,&random32bit);
      count++;
    }
  }
  if(s >= 60)
  {
    s = 0;
    m++;
  }
  if(m >= 60)
  {
    m = 0;
    h++;
  }
  if(h >= 24)
  {
    h = 0;
  }
 }
void LED_Show(void)
{
    LED_Set(led);
}
void LCD_Show(void)
{
  sprintf(text,"     Time:%d:%d:%d         ",h,m,s);
  LCD_DisplayStringLine(Line0, (unsigned char *)text);
  sprintf(text," K1:%d K2:%d K3:%d K4:%d      ",key1_1,key2_1,key3_1,key4_1);
  LCD_DisplayStringLine(Line1, (unsigned char *)text);
  sprintf(text,"    random32bit:%d    ",random32bit%7);
  LCD_DisplayStringLine(Line2, (unsigned char *)text);
}


void HAL_TIM_PeriodElapsedCallback(TIM_HandleTypeDef *htim)
{
  if(htim->Instance == TIM2)
  {
    ms++;
     if(ms%1000 <= n*10)
    {
      led = 0x01;
    }
    else
    {
      led = 0x00;
    }

    if(ms%1000 == 0)
    {
      s++;
    }
  }
}
